## Kconfig
```kconfig
mainmenu "Maxio NVMe Tool Configuration"

menu "Driver Configuration"

source "modules/dnvme/Kconfig"

endmenu

menu "Library Configuration"

source "lib/Kconfig"

endmenu

menu "Application Configuration"

source "app/Kconfig"

endmenu
```

## app/Kconfig
```kconfig
menuconfig APPLICATION
	bool "NVMe Application"
	default y
	help
	  Say Y here to compile nvme application.

if APPLICATION

config APP_UNIT_TEST
	bool "NVMe Unit Test"
	default y
	help
	  Say Y here to compile nvme unit test program.

endif # APPLICATION
```

## lib/Kconfig
```kconfig
menuconfig LIBRARY
	bool "Library Support"
	default y
	help
	  Say Y here to compile library
```

## modules/dnvme/Kconfig
```kconfig
menuconfig DNVME
	bool "DNVME Support"
	default y
	help
	  Say Y here to compile dnvme modules.

if DNVME

config DNVME_CMB
	bool "Support Controller Memory Buffer"
	help
	  Say Y here to support controller memory buffer operation.

config DNVME_FLUSH_REG_WRITE
	bool "Flush Register Write"
	help
	  Say Y here if it is necessary to make the written register value
	  effective through read back. 

comment "DNVME Debug Options"

config DNVME_DEBUG
	bool "Enable Debugging Message"
	help
	  Say Y here to enable debugging messages in dnvme driver.

config DNVME_CHECK_MUTEX_LOCK
	bool "Check Mutex Lock"
	help
	  Say Y here to check whether mutex locking and unlocking positions
	  are reasonable.

	  If the state of mutex possession is unreasonable, the 
	  corresponding error or warning message will be generated.

endif # DNVME
```

## modules/udmabuf/Kconfig
```kconfig
menuconfig U_DMA_BUF
	bool "User space mappable DMA Buffer Support"
	help
	  Enable this to allow the udmabuf to be built.
	  udmabuf is a Linux device driver that allocates contiguous
	  memory blocks in the kernel space as DMA buffers and
	  makes them available from the user space.

	  If you don't know what to do here, say N.
```
